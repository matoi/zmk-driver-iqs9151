## behaviors/Kconfig
```kconfig
menuconfig ZMK_BEHAVIOR_TRACKPAD_TO_POS
    bool "Trackpad to position behavior"
    default y
    help
      Enable the trackpad-to-position behavior that raises position_state_changed
      events for a virtual key position.

menuconfig ZMK_BEHAVIOR_ZIP_DYNAMIC_SCALE
    bool "Dynamic scale adjust behavior"
    default y
    help
      Enable the behavior that adjusts the dynamic scale factor used by
      the dynamic scaler input processor.

menuconfig ZMK_BEHAVIOR_PAD_TOUCH
    bool "Pad touch cross-pad behavior"
    default y
    depends on INPUT_IQS9151_CROSS_PAD
    help
      Enable the pad_touch behavior that receives cross-pad touch
      state from the central side via INVOKE_BEHAVIOR.

menuconfig ZMK_BEHAVIOR_ZIP_DYNAMIC_SCALE_SET
    bool "Dynamic scale set behavior"
    default y
    help
      Enable the behavior that sets the dynamic scale factor used by
      the dynamic scaler input processor.
```

## dts/bindings/behavior/zmk,behavior-pad-touch.yaml
```yaml
description: |
  Cross-pad touch state receiver behavior.
  Receives finger_count from the central side via INVOKE_BEHAVIOR
  and updates the local IQS9151 driver's peer state.

compatible: "zmk,behavior-pad-touch"

properties:
  display-name:
    type: string

  label:
    type: string
    required: false
    deprecated: true

  "#binding-cells":
    type: int
    required: true
    const: 2
```

## dts/bindings/input/azoteq,iqs9151.yaml
```yaml
description: |
  Azoteq IQS9151 driver placeholder.

compatible: "azoteq,iqs9151"

include: i2c-device.yaml

properties:
  irq-gpios:
    type: phandle-array
    required: true
    description: Interrupt GPIO for IQS9151 driver.
  cross-pad-peer-input:
    type: phandle
    required: false
    description: |
      Reference to the zmk,input-split proxy device that receives
      input events from the peer side's trackpad. Used on the central
      side to listen for cross-pad EV_MSC events from the peripheral.
```

## dts/bindings/input_processors/zmk,input-processor-cross-pad-gate.yaml
```yaml
description: |
  Suppresses REL events from the peripheral proxy device while
  a cross-pad gesture is active on the central side.

compatible: "zmk,input-processor-cross-pad-gate"

include: ip_zero_param.yaml
```
